## components/mao_app/Kconfig
```kconfig
menu "MAO application"

    config MAO_SLEEPY_TIMEOUT_S
        int "Seconds without input before MAO becomes sleepy"
        range 10 3600
        default 600
        help
            Purely visual/application idle state; the chip does not sleep.
            Before this, the character's own energy drive already makes it
            yawn, drowse and doze on its own.

endmenu
```

## components/mao_battery/Kconfig
```kconfig
menu "MAO battery"

    config MAO_BATTERY_CRITICAL_MV
        int "Critical cell voltage (mV, loaded)"
        range 3000 3800
        default 3550
        help
            On battery, a cell voltage below this (three gauge readings in a
            row, or SOC <= 2 %) posts MAO_EVENT_BATTERY_CRITICAL and the
            application puts MAO into its critical-battery deep sleep.
            Provisional floor 3.55 V under load from M5 Gate C (the panel and
            radio peaks must not reach the regulator's dropout / the 3V3
            UVLO). VERIFY AT BRING-UP against the measured discharge curve.

    config MAO_BATTERY_CRITICAL_SLEEP
        bool "Deep sleep on a critical battery"
        default y
        help
            After MAO_EVENT_BATTERY_CRITICAL the application lets MAO fall
            asleep (the resting mark, then deep sleep) with only the press
            and a recheck timer as wake sources.

    config MAO_BATTERY_CRITICAL_RECHECK_MIN
        int "Critical-battery deep sleep: recheck timer (minutes)"
        depends on MAO_BATTERY_CRITICAL_SLEEP
        range 5 1440
        default 60
        help
            Plugging USB in wakes the A1 (USB_PRESENT_N on the RTC pad GPIO2);
            the timer stays as a fallback that looks at the cell again (a cell
            that recovered, a board without the USB wake line).

endmenu
```

## components/mao_board/Kconfig
```kconfig
menu "MAO board"

    choice MAO_BOARD
        prompt "Board"
        default MAO_BOARD_LCDKIT if IDF_TARGET_ESP32C3
        default MAO_BOARD_MAIN_A1 if IDF_TARGET_ESP32S3
        help
            The hardware MAO runs on. Each board belongs to one chip, so the
            target (the tools/idf.ps1 profile) picks the matching board.

        config MAO_BOARD_LCDKIT
            bool "ESP32-C3-LCDkit (Espressif development kit)"
            depends on IDF_TARGET_ESP32C3

        config MAO_BOARD_MAIN_A1
            bool "MAO_MAIN A1 (ESP32-S3-MINI-1-N8)"
            depends on IDF_TARGET_ESP32S3
    endchoice

    choice MAO_A1_LCD_ROTATION
        prompt "MAO_MAIN A1: display rotation"
        depends on MAO_BOARD_MAIN_A1
        default MAO_A1_LCD_ROTATION_90
        help
            How the round panel is turned in the puck relative to the LCDkit
            mounting (FPC tail towards 6 o'clock), in clockwise degrees. The
            panel tail leaves at 9 o'clock (as on the A0), a 90 degree turn,
            hence the default.

            VERIFY AT BRING-UP: the direction of that turn as seen by the
            controller is not known until the face is on screen. If the eyes
            appear rotated, try 270 live with "mao rotate 270" (dev console),
            then "mao rotate save" or fix it here.

        config MAO_A1_LCD_ROTATION_0
            bool "0 (as on the LCDkit)"
        config MAO_A1_LCD_ROTATION_90
            bool "90"
        config MAO_A1_LCD_ROTATION_180
            bool "180"
        config MAO_A1_LCD_ROTATION_270
            bool "270"
    endchoice

    config MAO_A1_LCD_ROTATION_DEG
        int
        default 0 if MAO_A1_LCD_ROTATION_0
        default 90 if MAO_A1_LCD_ROTATION_90
        default 180 if MAO_A1_LCD_ROTATION_180
        default 270 if MAO_A1_LCD_ROTATION_270
        default 0

    config MAO_A1_LCD_PCLK_MHZ
        int "MAO_MAIN A1: display SPI clock (MHz)"
        depends on MAO_BOARD_MAIN_A1
        range 10 80
        default 80
        help
            The GC9A01 SPI clock (SPI2 on its IO_MUX pads). VERIFY AT
            BRING-UP: run the colour test and the animation at 80 MHz; if lines
            tear or pixels go wrong, set 40 here. Use 80 or 40: the SPI clock
            divides 80 MHz, so other values round to a neighbouring 80/n.

    # Not user-editable: the name always follows the board choice.
    config MAO_BOARD_NAME
        string
        default "ESP32-C3-LCDkit" if MAO_BOARD_LCDKIT
        default "MAO_MAIN A1" if MAO_BOARD_MAIN_A1
        default "unsupported"

endmenu
```

## components/mao_display/Kconfig
```kconfig
menu "MAO display"

    config MAO_PERF_PROBE
        bool "Frame performance probe (development)"
        default y
        help
            Measure rendered frames, frame time and render load, and log a
            summary periodically while the screen is animating. Disable for
            release builds.

    config MAO_PERF_PERIOD_S
        int "Performance summary period (seconds)"
        depends on MAO_PERF_PROBE
        range 2 120
        default 10

endmenu
```

## components/mao_perception/Kconfig
```kconfig
menu "MAO perception"

    config MAO_PERCEPT_NEAR_MM
        int "Proximity: 'near' distance through the window (mm)"
        range 50 800
        default 200
        help
            Something closer than this (two readings in a row) is
            APPROACH_NEAR; it has to move 50 % further away again before it
            counts as gone (hysteresis). VERIFY AT BRING-UP through the
            cover window: the window border adds crosstalk.

    config MAO_PERCEPT_QUIET_ROOM_S
        int "Quiet room after this many seconds of quiet"
        range 10 3600
        default 120

    config MAO_PERCEPT_DARK_ROOM_S
        int "Dark room after this many seconds of darkness"
        range 5 600
        default 20

    config MAO_PERCEPT_LONG_ABSENCE_MIN
        int "Long absence: minutes without anyone around"
        range 5 10080
        default 120
        help
            When someone comes back after at least this long (counting
            deep sleep), MAO perceives LONG_ABSENCE before anything else.

    config MAO_PERCEPT_IMU_Z_DOWN
        bool "IMU +Z points down when MAO rests on its base"
        default n
        help
            The LSM6DSOX sits on the face side of the A0, so its +Z axis
            should point up out of the face when MAO rests on its base.
            VERIFY AT BRING-UP with "mao sense" (accel z = +1 g at rest);
            enable this if it reads -1 g.

    config MAO_PERCEPT_LOG
        bool "Log every percept"
        default y
        help
            One INFO line per percept (release builds log WARN and above
            only, so this costs nothing there). "mao percept log off"
            silences it at run time.

endmenu
```

## components/mao_power/Kconfig
```kconfig
menu "MAO power"

    config MAO_POWER_WAKE_INTERVAL_MIN
        int "Deep-sleep housekeeping wake-up interval (minutes)"
        range 1 1440
        default 30
        help
            Timer wake-up while in deep sleep, so MAO can update its state
            (battery, time asleep) even when nobody touches it.

    config MAO_POWER_CRITICAL_SHUTDOWN
        bool "Deep sleep on a critical battery"
        default y
        help
            On battery with SOC <= 2 % or the cell below 3.35 V (three
            readings in a row), post MAO_EVENT_BATTERY_CRITICAL, give the
            application 5 s to save state, then deep-sleep with USB as the
            only wake source. The hardware UVLO switches the 3V3 rail off
            near 2.96 V VSYS; this keeps the firmware well clear of it.

    config MAO_POWER_AUTO
        bool "Automatic power states (ACTIVE / IDLE / DROWSY / DEEP SLEEP)"
        default y
        help
            Let MAO doze off on its own: IDLE after a short while without
            anyone around (sensors slower), DROWSY later (panel asleep, CPU
            light-sleeping between wake events), DEEP SLEEP after a long
            doze on battery. Boards without power management ignore this.
            Without it, only "mao sleep" and a critical battery change the
            power state.

    config MAO_POWER_IDLE_AFTER_S
        int "IDLE after this many seconds without activity"
        depends on MAO_POWER_AUTO
        range 5 3600
        default 30

    config MAO_POWER_DROWSY_AFTER_S
        int "DROWSY after this many seconds without activity"
        depends on MAO_POWER_AUTO
        range 20 86400
        default 180
        help
            The application's sleepy look (MAO_SLEEPY_TIMEOUT_S, dimmed
            screen, heavy eyes) comes first; DROWSY then puts the panel to
            sleep and light-sleeps the CPU.

    config MAO_POWER_DEEP_AFTER_MIN
        int "DEEP SLEEP after this many minutes DROWSY (0 = never)"
        depends on MAO_POWER_AUTO
        range 0 1440
        default 30

    config MAO_POWER_REDROWSE_S
        int "After a wake nobody follows up, doze off again after (s)"
        depends on MAO_POWER_AUTO
        range 5 600
        default 20
        help
            A bump of the desk or a passing shadow wakes MAO from DROWSY;
            if nothing else happens it looks around this long, then dozes
            off again instead of waiting the full DROWSY delay.

    config MAO_POWER_SLEEP_WITH_CONSOLE
        bool "Sleep even while a USB host uses the console"
        depends on MAO_POWER_AUTO
        default n
        help
            Light and deep sleep drop the USB-Serial/JTAG connection. By
            default MAO never goes below IDLE while a USB host is attached
            (start-of-frame packets seen), so development sessions and the
            factory fixture keep their console.

    config MAO_POWER_DEEP_ON_USB
        bool "Deep sleep while on USB power"
        depends on MAO_POWER_AUTO
        default n
        help
            On a charger MAO dozes (DROWSY) but stays out of deep sleep by
            default, so it wakes instantly and keeps its sense of time.

    config MAO_POWER_QUIET_WAKE_S
        int "Look-around time after a housekeeping timer wake (s)"
        depends on MAO_POWER_AUTO
        range 2 120
        default 8
        help
            The deep-sleep housekeeping timer boots MAO with the screen
            dark. If nothing happens within this time it goes straight
            back to deep sleep.

endmenu
```

## components/mao_selftest/Kconfig
```kconfig
menu "MAO self-test"

    config MAO_SELFTEST_AT_BOOT
        bool "Run the factory self-test at every boot (factory build)"
        default n
        help
            For assembled-board validation: two seconds after MAO is ready
            the self-test runs (output on the USB console, verdict on the
            screen), exactly as "mao selftest" does. Build it with the
            factory profile (sdkconfig.factory); never ship it.

    config MAO_SELFTEST_AT_BOOT_INTERACTIVE
        bool "Include the operator steps (look, listen, turn, press, touch)"
        depends on MAO_SELFTEST_AT_BOOT
        default y

    config MAO_SELFTEST_PROMPT_TIMEOUT_S
        int "Seconds to wait for the operator at each prompt"
        range 5 300
        default 20

endmenu
```

## components/mao_system/Kconfig
```kconfig
menu "MAO system"

    config MAO_DEV_CONSOLE
        bool "Development console (serial line commands)"
        default y
        help
            Poll the USB-Serial/JTAG console for development commands such as
            "mao reset-first-boot" and "mao stress 20". Disable for release.

endmenu
```

## devices/lamp_01_test/main/Kconfig.projbuild
```kconfig
menu "LAMP 01 test device"

    config LAMP_PROFILE_CAMERA
        bool "Build the CAMERA 01 profile instead of LAMP 01 (LIGHT)"
        default n
        help
            The same bench firmware emulates either a LIGHT (POWER, LEVEL,
            IDENTIFY) or a camera-shaped device (CAPTURE, IDENTIFY,
            SYNC_TEST, READY, STORAGE). Protocol simulator only - no real
            camera exists here.


    choice LAMP_OUTPUT
        prompt "How LEVEL is shown"
        default LAMP_OUTPUT_LOG
        help
            LEVEL/POWER changes are always logged. Optionally also drive an LED.

        config LAMP_OUTPUT_LOG
            bool "Serial log only"
        config LAMP_OUTPUT_WS2812
            bool "Addressable RGB LED (WS2812)"
        config LAMP_OUTPUT_PWM
            bool "Plain LED on a GPIO (LEDC PWM)"
    endchoice

    config LAMP_LED_GPIO
        int "LED GPIO"
        depends on !LAMP_OUTPUT_LOG
        range 0 21
        default 8

    config LAMP_LED_ACTIVE_LOW
        bool "LED is active low"
        depends on LAMP_OUTPUT_PWM
        default n

endmenu
```

## devices/lamp_01_test/sdkconfig.defaults
```kconfig
CONFIG_IDF_TARGET="esp32c3"
CONFIG_ESPTOOLPY_FLASHSIZE_4MB=y
CONFIG_FREERTOS_HZ=1000

# ESP-NOW only (same trimmed Wi-Fi profile as MAO).
CONFIG_ESP_WIFI_IRAM_OPT=n
CONFIG_ESP_WIFI_RX_IRAM_OPT=n
CONFIG_ESP_WIFI_STATIC_RX_BUFFER_NUM=4
CONFIG_ESP_WIFI_DYNAMIC_RX_BUFFER_NUM=16
CONFIG_ESP_WIFI_DYNAMIC_TX_BUFFER_NUM=16
CONFIG_ESP_WIFI_AMPDU_TX_ENABLED=n
CONFIG_ESP_WIFI_AMPDU_RX_ENABLED=n
CONFIG_ESP_WIFI_SOFTAP_SUPPORT=n
CONFIG_ESP_WIFI_NVS_ENABLED=n
```
